## boards/arm/patkb_pcb/Kconfig.board
```kconfig
# patkb custom nRF52840 PCB

# SPDX-License-Identifier: MIT

config BOARD_PATKB_PCB
    bool "patkb pcb"
    depends on SOC_NRF52840_QIAA
```

## boards/arm/patkb_pcb/Kconfig.defconfig
```kconfig
# SPDX-License-Identifier: MIT

if BOARD_PATKB_PCB

config BOARD
    default "patkb_pcb"

if USB_DEVICE_STACK

config USB_NRFX
    default y

endif # USB_DEVICE_STACK

config BT_CTLR
    default BT

# Sharp memory LCD (LS013B7DH03, 128x128, 1 bit per pixel)
if ZMK_DISPLAY

config LV_Z_VDB_SIZE
    default 100

config LV_Z_BITS_PER_PIXEL
    default 1

choice LV_COLOR_DEPTH
    default LV_COLOR_DEPTH_1
endchoice

choice ZMK_DISPLAY_WORK_QUEUE
    default ZMK_DISPLAY_WORK_QUEUE_DEDICATED
endchoice

endif # ZMK_DISPLAY

endif # BOARD_PATKB_PCB
```
